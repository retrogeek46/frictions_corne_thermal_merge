## boards/shields/corny/Kconfig.defconfig
```kconfig
if SHIELD_CORNY_PAD

config ZMK_KEYBOARD_NAME
    default "Corne"

config ZMK_SPLIT_ROLE_CENTRAL
    default y

endif

if SHIELD_CORNY_LEFT || SHIELD_CORNY_RIGHT || SHIELD_CORNY_PAD

config ZMK_SPLIT
    default y

endif
```

## boards/shields/corny/Kconfig.shield
```kconfig
config SHIELD_CORNY_LEFT
    def_bool $(shields_list_contains,corny_left)

config SHIELD_CORNY_RIGHT
    def_bool $(shields_list_contains,corny_right)

config SHIELD_CORNY_PAD
    def_bool $(shields_list_contains,corny_pad)
```

## config/west.yml
```yaml
manifest:
  remotes:
    - name: zmkfirmware
      url-base: https://github.com/zmkfirmware
    - name: caksoylar
      url-base: https://github.com/caksoylar
  projects:
    - name: zmk
      remote: zmkfirmware
      revision: abb64ba316c29caddc49727ca2cac2f0ed5970c7
      import: app/west.yml
    - name: zmk-rgbled-widget
      remote: caksoylar
      revision: main
  self:
    path: config
```
